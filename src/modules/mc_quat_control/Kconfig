## src/modules/mc_quat_control/Kconfig
```kconfig
menuconfig MODULES_MC_QUAT_CONTROL
	bool "mc_quat_control"
	default n
	---help---
		Enable support for mc_quat_control

menuconfig USER_MC_QUAT_CONTROL
	bool "mc_quat_control running as userspace module"
	default n
	depends on BOARD_PROTECTED && MODULES_MC_QUAT_CONTROL
	---help---
		Put mc_quat_control in userspace memory
```

## src/modules/px4_hanna_app/Kconfig
```kconfig
menuconfig MODULES_PX4_HANNA_APP
	bool "px4_hanna_app"
	default n
	---help---
		Enable support for px4_hanna_app

menuconfig USER_PX4_HANNA_APP
	bool "px4_hanna_app running as userspace module"
	default y
	depends on BOARD_PROTECTED && MODULES_MC_POS_CONTROL
	---help---
		Put px4_hanna_app in userspace memory
```
